## firmware/sdkconfig.defaults
```kconfig
# Baseline defaults derived from docs/research/esp-idf-skeleton-baseline.md.

# WebSocket support is reserved for later browser/API control work.
CONFIG_HTTPD_WS_SUPPORT=y

# Keep request headers large enough for browser clients and auth experiments.
CONFIG_HTTPD_MAX_REQ_HDR_LEN=8192

# Networking headroom inherited from the ESP-IDF skeleton baseline research.
CONFIG_LWIP_MAX_SOCKETS=24
CONFIG_LWIP_TCP_SND_BUF_DEFAULT=65535
CONFIG_LWIP_TCP_WND_DEFAULT=65535
CONFIG_LWIP_TCPIP_TASK_STACK_SIZE=6144
```

## firmware/sdkconfig.defaults.esp32p4
```kconfig
# ESP32-P4 target defaults derived from docs/research/esp-idf-skeleton-baseline.md.

# PSRAM is a baseline requirement for the planned capture and encode path.
CONFIG_SPIRAM=y
CONFIG_SPIRAM_MODE_HEX=y
CONFIG_SPIRAM_SPEED_200M=y

# Reserve the TinyUSB HID count baseline without enabling HID behavior yet.
CONFIG_TINYUSB_HID_COUNT=1
```
